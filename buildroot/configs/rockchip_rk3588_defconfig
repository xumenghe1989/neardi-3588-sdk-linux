## buildroot/configs/rockchip_rk3588_defconfig
```kconfig
#include "rk3588_aarch64.config"
#include "base.config"
#include "base_extra.config"
#include "rk3588_arm64.config"
#include "npu2.config"
#include "debug.config"
#include "audio.config"
#include "audio_gst.config"
#include "camera.config"
#include "camera_gst.config"
#include "weston.config"
#include "chromium.config"
#include "gpu.config"
#include "npu2.config"
#include "powermanager.config"
#include "video_mpp.config"
#include "video_gst.config"
#include "video_gst_rtsp.config"
#include "ntfs.config"
#include "benchmark.config"
#include "debug.config"
#include "test.config"
#include "network.config"
#include "bt.config"
BR2_TARGET_GENERIC_ROOT_PASSWD="root"
BR2_PACKAGE_RKWIFIBT_AP6275P=y
BR2_PACKAGE_RKWIFIBT_BTUART="ttyS9"
BR2_PACKAGE_BTRFS_PROGS=y
BR2_PACKAGE_IPROUTE2=y
BR2_PACKAGE_IPTABLES=y
BR2_PACKAGE_IPTABLES_BPF_NFSYNPROXY=y
BR2_PACKAGE_DOCKER_CLI=y
BR2_PACKAGE_DOCKER_CLI_STATIC=y
BR2_PACKAGE_DOCKER_PROXY=y
BR2_PACKAGE_XORG7=y
BR2_USE_WCHAR=y
BR2_PACKAGE_LIBGLIB2=y
BR2_PACKAGE_XLIB_LIBX11=y
BR2_PACKAGE_DOCKER_ENGINE=y
BR2_PACKAGE_CA_CERTIFICATES=y
```

## kernel/drivers/bluetooth/skwbt/Kconfig.txt
```kconfig
config SKW_BT
        tristate "Seekwave BT driver"
        depends on SEEKWAVE_BSP_DRIVERS && MMC
        help
          The driver for seekwave Bluetooth chipsets with SDIO/USB interface.

          Say Y here to compile support for Seekwave BT-over-SDIO/USB driver
          into the kernel or say M to compile it as module.
```

## kernel/drivers/net/wireless/rockchip_wlan/rtl8852bs/Kconfig
```kconfig
config RTL8852BS
	tristate "Realteck 8852B SDIO WiFi"
	help
	Help message of RTL8852BS
```
